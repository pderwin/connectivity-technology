## CMakeLists.txt
```
# /*============================================================================*
#  *         Copyright © 2019-2021 Signetik, LLC -- All Rights Reserved         *
#  *----------------------------------------------------------------------------*
#  *                                                              Signetik, LLC *
#  *                                                           www.signetik.com *
#  *                                          SPDX-License-Identifier: Sigentik *
#  *                                                                            *
#  * Customer may modify, compile, assemble and convert this source code into   *
#  * binary object or executable code for use on Signetk products purchased     *
#  * from Signetik or its distributors.                                         *
#  *                                                                            *
#  * Customer may incorporate or embed an binary executable version of the      *
#  * software into the Customer’s product(s), which incorporate a Signetik      *
#  * product purchased from Signetik or its distributors. Customer may          *
#  * manufacture, brand and distribute such Customer’s product(s) worldwide to  *
#  * its End-Users.                                                             *
#  *                                                                            *
#  * This agreement must be formalized with Signetik before Customer enters     *
#  * production and/or distributes products to Customer's End-Users             *
#  *============================================================================*/

cmake_minimum_required(VERSION 3.20)

set(LORA_BASICS_ROOT       $ENV{ZEPHYR_BASE}/../SWSD004 )

set(APPS                   ${LORA_BASICS_ROOT}/apps )
set(LORA_BASICS_MODEM      ${LORA_BASICS_ROOT}/lora_basics_modem/lora_basics_modem )
set(SMTC_MODEM_CORE        ${LORA_BASICS_MODEM}/smtc_modem_core )
set(SMTC_MODEM_SERVICES    ${SMTC_MODEM_CORE}/smtc_modem_services )
set(LR1MAC                 ${SMTC_MODEM_CORE}/lr1mac )

set(GEOLOCATION_MIDDLEWARE ${LORA_BASICS_ROOT}/geolocation_middleware )
set(SMTC_HAL               ${LORA_BASICS_ROOT}/smtc_hal )
set(PRINTERS               ${LORA_BASICS_ROOT}/lora_basics_modem/printers )
set(SHIELDS                ${LORA_BASICS_ROOT}/shields )
set(NRF52840               ${LORA_BASICS_ROOT}/smtc_hal/Nordic/nRF52840 )

set(FIRMWARE_UPDATE_ROOT   $ENV{ZEPHYR_BASE}/../SWTL001 )

set(CONNECTIVITY_TECHNOLOGY $ENV{ZEPHYR_BASE}/../connectivity-technology )

set(ZEPHYR_EXTRA_MODULES
        ${CONNECTIVITY_TECHNOLOGY}
        ${LORA_BASICS_ROOT}
        ${FIRMWARE_UPDATE_ROOT}
        $ENV{ZEPHYR_BASE}/../nrf
        $ENV{ZEPHYR_BASE}/../modules/hal/nordic
        $ENV{ZEPHYR_BASE}/../modules/hal/cmsis
        $ENV{ZEPHYR_BASE}/../modules/debug/segger
        $ENV{ZEPHYR_BASE}/../modules/crypto/tinycrypt
        $ENV{ZEPHYR_BASE}/../nrfxlib
  )

find_package(Zephyr REQUIRED HINTS $ENV{ZEPHYR_BASE})

project(client)

zephyr_compile_definitions( REGION_US_915=1 )
zephyr_compile_definitions( LR11XX=1 )
zephyr_compile_definitions( LR11XX_TRANSCEIVER=1 )
zephyr_compile_definitions( MODEM_HAL_DBG_TRACE=0 )
zephyr_compile_definitions( TASK_EXTENDED_2 )

# zephyr_compile_options( -Wextra -Werror )

set(sources
        src/main.c
)

# Main app
target_sources(app PRIVATE ${sources})

#
# _sigver.c is a generated file from the ver.sh script.  Don't need it for now.
#
# target_sources(app PRIVATE _sigver.c)

# target_sources_ifdef(CONFIG_SIGNETIK_APP_LORATEST app PRIVATE src/loratest_task.c)

zephyr_include_directories( ${APPS}/common )

zephyr_include_directories( ${CONNECTIVITY_TECHNOLOGY}/src/pe4259 )

zephyr_include_directories( ${GEOLOCATION_MIDDLEWARE}/common )
zephyr_include_directories( ${GEOLOCATION_MIDDLEWARE}/gnss/src )
zephyr_include_directories( ${GEOLOCATION_MIDDLEWARE}/wifi/src )


zephyr_include_directories( ${LORA_BASICS_MODEM} )
zephyr_include_directories( ${LORA_BASICS_MODEM}/smtc_modem_api )
zephyr_include_directories( ${LORA_BASICS_MODEM}/smtc_modem_core/radio_drivers/lr11xx_driver/src )
zephyr_include_directories( ${LORA_BASICS_MODEM}/smtc_modem_core/radio_planner/src )
zephyr_include_directories( ${LORA_BASICS_MODEM}/smtc_modem_core/smtc_ral/src )
zephyr_include_directories( ${LORA_BASICS_MODEM}/smtc_modem_core/smtc_ralf/src )
zephyr_include_directories( ${LORA_BASICS_MODEM}/smtc_modem_core/smtc_modem_crypto )
zephyr_include_directories( ${LORA_BASICS_MODEM}/smtc_modem_core/smtc_modem_crypto/smtc_secure_element )
zephyr_include_directories( ${LORA_BASICS_MODEM}/smtc_modem_hal )
zephyr_include_directories( ${LORA_BASICS_MODEM}/utilities/user_app/smtc_hal_l4 )

zephyr_include_directories( ${LR1MAC} )
zephyr_include_directories( ${LR1MAC}/src )
zephyr_include_directories( ${LR1MAC}/src/lr1mac_class_b )
zephyr_include_directories( ${LR1MAC}/src/lr1mac_class_c )
zephyr_include_directories( ${LR1MAC}/src/services )
zephyr_include_directories( ${LR1MAC}/src/smtc_real/src )

zephyr_include_directories( ${NRF52840}/inc )  # smtc_hal_flash_mapping.h

zephyr_include_directories( ${PRINTERS} )

zephyr_include_directories( ${SHIELDS} )
zephyr_include_directories( ${SHIELDS}/interface )
zephyr_include_directories( ${SHIELDS}/LR11XX/radio_drivers_hal )
zephyr_include_directories( ${SHIELDS}/LR11XX/smtc_shield_lr11xx/common/inc )
zephyr_include_directories( ${SHIELDS}/LR11XX/LR1110TRK1xKS/BSP/board )
zephyr_include_directories( ${SHIELDS}/LR11XX/LR1110TRK1xKS/BSP/peripherals/Leds )
zephyr_include_directories( ${SHIELDS}/LR11XX/LR1110TRK1xKS/BSP/peripherals/hall_effect )
zephyr_include_directories( ${SHIELDS}/LR11XX/LR1110TRK1xKS/BSP/peripherals/usr_button )

zephyr_include_directories( ${SMTC_HAL}/board )
zephyr_include_directories( ${SMTC_HAL}/inc )

zephyr_include_directories( ${SMTC_MODEM_CORE}/device_management )
zephyr_include_directories( ${SMTC_MODEM_CORE}/lorawan_api )
zephyr_include_directories( ${SMTC_MODEM_CORE}/modem_config )
zephyr_include_directories( ${SMTC_MODEM_CORE}/modem_services )
zephyr_include_directories( ${SMTC_MODEM_CORE}/modem_supervisor )

zephyr_include_directories( ${SMTC_MODEM_SERVICES} )
zephyr_include_directories( ${SMTC_MODEM_SERVICES}/headers )
zephyr_include_directories( ${SMTC_MODEM_SERVICES}/src )
zephyr_include_directories( ${SMTC_MODEM_SERVICES}/src/stream )

zephyr_include_directories( ${FIRMWARE_UPDATE_ROOT}/application/inc )
zephyr_include_directories( ${FIRMWARE_UPDATE_ROOT}/lr1110_modem_driver/src )
```

## prj.conf
```kconfig
# /*============================================================================*
#  *         Copyright © 2019-2021 Signetik, LLC -- All Rights Reserved         *
#  *----------------------------------------------------------------------------*
#  *                                                              Signetik, LLC *
#  *                                                           www.signetik.com *
#  *                                          SPDX-License-Identifier: Sigentik *
#  *                                                                            *
#  * Customer may modify, compile, assemble and convert this source code into   *
#  * binary object or executable code for use on Signetk products purchased     *
#  * from Signetik or its distributors.                                         *
#  *                                                                            *
#  * Customer may incorporate or embed an binary executable version of the      *
#  * software into the Customer’s product(s), which incorporate a Signetik      *
#  * product purchased from Signetik or its distributors. Customer may          *
#  * manufacture, brand and distribute such Customer’s product(s) worldwide to  *
#  * its End-Users.                                                             *
#  *                                                                            *
#  * This agreement must be formalized with Signetik before Customer enters     *
#  * production and/or distributes products to Customer's End-Users             *
#  *============================================================================*/

CONFIG_SYSTEM_WORKQUEUE_STACK_SIZE=2048

CONFIG_BASE64=y
CONFIG_BT=y
CONFIG_BT_DEBUG_LOG=y
CONFIG_BT_SMP=y
CONFIG_BT_SIGNING=y
CONFIG_BT_PERIPHERAL=y
CONFIG_BT_DEVICE_NAME="SigLR_N1"
CONFIG_BT_DEVICE_APPEARANCE=833
CONFIG_BT_DEVICE_NAME_DYNAMIC=y
CONFIG_BT_DEVICE_NAME_MAX=65
CONFIG_BT_SMP=y
CONFIG_BT_GATT_CLIENT=y
CONFIG_BT_GATT_DM=y
CONFIG_BT_GATT_DM_DATA_PRINT=y
CONFIG_BT_HCI=y
CONFIG_BT_CTLR=y
CONFIG_BT_LL_SW_SPLIT=y

CONFIG_BT_KEYS_OVERWRITE_OLDEST=y
CONFIG_BT_SETTINGS=y
CONFIG_FLASH=y
CONFIG_FLASH_PAGE_LAYOUT=y
CONFIG_FLASH_MAP=y
CONFIG_NVS=y
CONFIG_SETTINGS=y

CONFIG_SPI=y
CONFIG_ARM_MPU=y
CONFIG_LORA=y
CONFIG_LORA_SX12XX=y
CONFIG_LORAWAN=y
CONFIG_LORAMAC_REGION_US915=y
CONFIG_CONSOLE=y
CONFIG_UART_CONSOLE=y
CONFIG_SERIAL=y
#CONFIG_SPI_0=y
CONFIG_GPIO=y
CONFIG_NFCT_PINS_AS_GPIOS=y
CONFIG_CLOCK_CONTROL_NRF_K32SRC_RC=y
CONFIG_CLOCK_CONTROL_NRF_K32SRC_250PPM=y

CONFIG_SENSOR_POLLING_METHOD_UART_BINARY=y
CONFIG_SENSOR_POLLING_METHOD_UART_PUSH=y
CONFIG_WATCHDOG=y

# RTT Debug (Yes, activate J-Link console via Segger RTT)
CONFIG_USE_SEGGER_RTT=y
CONFIG_RTT_CONSOLE=y
CONFIG_UART_RTT=y

#CONFIG_SIGNETIK_MODEM_API=y
CONFIG_PINCTRL=y
CONFIG_SIGNETIK_APP_LORATEST=y
CONFIG_LORAWAN_NVM_NONE=y

#
#
#
CONFIG_SYS_CLOCK_TICKS_PER_SEC=32768

#
# enable LIS2DH accelerometer
#
# CONFIG_LIS2DH=y
CONFIG_LIS2DH_TRIGGER_OWN_THREAD=y
CONFIG_LIS2DH_ACCEL_HP_FILTERS=y

#
# Allow to get thread entry points.
#
# CONFIG_THREAD_MONITOR=y
#
# allow to name threads
#
CONFIG_THREAD_NAME=y

#
# Enable tracing in general.
#
CONFIG_LXK_TRACE=y
CONFIG_LXK_TRACE_SWAPS=y
```

## src/main.c
```c
#include <zephyr/kernel.h>
/*-------------
 *
 * GPIO assignments
 */
int main()
{
   printk("Hello World from Moko!!! \n");
   return 0;
}
```
